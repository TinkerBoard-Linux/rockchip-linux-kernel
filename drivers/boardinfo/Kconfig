## drivers/boardinfo/Kconfig
```kconfig
#
# boardinfo drivers
#
# When adding new entries keep the list in alphabetical order

config BOARDINFO
	tristate "ASUS boardinfo"
	default n
	help
	  Driver to set board information.
```

## drivers/input/pwmcapture/Kconfig
```kconfig
# ASUS PWM capture mode driver configuration

menu "ASUS PWM Capture Mode Driver"

config ASUS_PWM_CAPTURE
	tristate "asus pwm capture"
	default n
	help
	Say Y here, will suport asus pwm catpure mode.

endmenu
```
